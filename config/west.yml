## config/west.yml
```yaml
manifest:
  remotes:
    - name: zmkfirmware
      url-base: https://github.com/zmkfirmware
    - name: m165437 #ui
      url-base: https://github.com/M165437 #ui
  projects:
    - name: zmk
      remote: zmkfirmware
      revision: main
      import: app/west.yml
    - name: nice-view-gem #ui
      remote: m165437 #ui
      revision: main #ui
  self:
    path: config
```
